## components/WaveShare/Kconfig
```kconfig
# Kconfig file for WaveShare

menu "WaveShare configuration"

    config WS_USE_USB
        bool "Check this to use Usb Host"
        default n
    config WS_USE_GRBL_EXAMPLE
        bool "Check this to use Grbl Example"
        default n
        depends on WS_USE_USB
    config WS_USE_SDCARD
        bool "Check this to use SD Card"
        default n
    config WS_USE_NVS
        bool "Check this to use NVS"
        default n
    config WS_USE_LVGL
        bool "Check this to use LVGL"
        default n
    config WS_USE_SCREENSAVER
        bool "Check this to use Screensaver"
        default n
        depends on WS_USE_LVGL
    config WS_TIMER_VALUE
        int "Set the timer value in seconds for the screensaver"
        default 60
        depends on WS_USE_SCREENSAVER
                    
endmenu
```

## sdkconfig.defaults
```kconfig
# WaveShare ESP32-S3-LCD-4.3

# Idf
CONFIG_IDF_TARGET="esp32s3"

# Flash
CONFIG_ESPTOOLPY_FLASHMODE_QIO=y
CONFIG_ESPTOOLPY_FLASHSIZE_8MB=y

# Compiler
CONFIG_COMPILER_OPTIMIZATION_PERF=y
CONFIG_COMPILER_CXX_EXCEPTIONS=y

# Partition
CONFIG_PARTITION_TABLE_CUSTOM=y

# SpiRam
CONFIG_SPIRAM=y
CONFIG_SPIRAM_MODE_OCT=y
CONFIG_SPIRAM_FETCH_INSTRUCTIONS=y
CONFIG_SPIRAM_RODATA=y
CONFIG_SPIRAM_SPEED_80M=y

# System
CONFIG_ESP_DEFAULT_CPU_FREQ_MHZ_240=y
CONFIG_ESP32S3_DATA_CACHE_LINE_64B=y
CONFIG_FREERTOS_HZ=1000
CONFIG_ESP_TASK_WDT_EN=n
CONFIG_FREERTOS_TIMER_TASK_STACK_DEPTH=4096

# Fat
CONFIG_FATFS_LFN_HEAP=y
CONFIG_FATFS_API_ENCODING_UTF_8=y

# Lvgl
CONFIG_LV_ATTRIBUTE_FAST_MEM_USE_IRAM=y
CONFIG_LV_MEM_SIZE_KILOBYTES=64
CONFIG_LV_MEM_CUSTOM=y
CONFIG_LV_MEMCPY_MEMSET_STD=y
CONFIG_LV_CONF_SKIP=y
CONFIG_LV_USE_CLIB_MALLOC=y
CONFIG_LV_USE_CLIB_SPRINTF=y
CONFIG_LV_USE_CLIB_STRING=y
CONFIG_LV_USE_FS_STDIO=y
CONFIG_LV_FS_STDIO_LETTER=65
CONFIG_LV_FS_STDIO_PATH="/spiffs"
CONFIG_LV_FONT_MONTSERRAT_18=y
CONFIG_LV_USE_LODEPNG=y
CONFIG_LV_USE_SNAPSHOT=y

# WaveShare
CONFIG_WS_USE_USB=n
CONFIG_WS_USE_SDCARD=n
CONFIG_WS_USE_LVGL=y
CONFIG_WS_USE_NVS=y
CONFIG_WS_USE_SCREENSAVER=n
CONFIG_WS_TIMER_VALUE=60

# Wifi
CONFIG_LWIP_IPV6=y
```
